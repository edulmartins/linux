## Documentation/devicetree/bindings/clock/apple,t8010-touch-clock.yaml
```yaml
# SPDX-License-Identifier: (GPL-2.0-only OR BSD-2-Clause)
%YAML 1.2
---
$id: http://devicetree.org/schemas/clock/apple,t8010-touch-clock.yaml#
$schema: http://devicetree.org/meta-schemas/core.yaml#

title: Apple T7000/T8010 touchscreen clock controller

maintainers:
  - Paul Praschl <praschlpaul@g-p.at>

description:
  The T7000 and T8010 PMGR contain a gate and integer divider for the
  reference clock consumed by the touchscreen controller. The S8000 PMGR has
  the same block at the same offset; the iPad 5 N1 touchscreen runs it at
  32768 Hz. So has the T8015 PMGR, whose iPhone X touchscreen runs it at
  24 MHz.

properties:
  compatible:
    oneOf:
      - enum:
          - apple,t7000-touch-clock
          - apple,t8010-touch-clock
      - items:
          - enum:
              - apple,s8000-touch-clock
              - apple,t8015-touch-clock
          - const: apple,t8010-touch-clock

  reg:
    maxItems: 1

  clocks:
    maxItems: 1

  '#clock-cells':
    const: 0

  clock-output-names:
    maxItems: 1

  clock-frequency:
    description: Target clock rate in Hz

required:
  - compatible
  - reg
  - clocks
  - '#clock-cells'
  - clock-frequency

additionalProperties: false

examples:
  - |
    clock-controller@78000 {
        compatible = "apple,t8010-touch-clock";
        reg = <0x78000 0x8>;
        #clock-cells = <0>;
        clocks = <&clkref>;
        clock-output-names = "touchclk";
        clock-frequency = <24000000>;
    };
...
```

## Documentation/devicetree/bindings/input/touchscreen/apple,d221-touchscreen.yaml
```yaml
# SPDX-License-Identifier: (GPL-2.0-only OR BSD-2-Clause)
%YAML 1.2
---
$id: http://devicetree.org/schemas/input/touchscreen/apple,d221-touchscreen.yaml#
$schema: http://devicetree.org/meta-schemas/core.yaml#

title: Apple iPhone X HIDSPI touchscreen

maintainers:
  - Eduardo Martins <eduardo@martins.ws>

description:
  The iPhone X touch controller (ADT "hid-transport,k1") on an SPI bus. It
  starts in an HBPP bootloader that loads its firmware from the host, then
  reports touches over Apple's HIDSPI transport. Its per-unit calibrations
  come from the ADT's multi-touch node; the bootloader copies them through
  the touchscreen0 alias.

allOf:
  - $ref: touchscreen.yaml#
  - $ref: /schemas/spi/spi-peripheral-props.yaml#

properties:
  compatible:
    const: apple,d221-touchscreen

  reg:
    maxItems: 1

  interrupts:
    maxItems: 1

  reset-gpios:
    maxItems: 1

  ana-supply:
    description: Analog supply of the touch controller.

  clocks:
    maxItems: 1

  firmware-name:
    maxItems: 1
    description:
      Start of the controller firmware's file name; the driver appends
      -<apple,hid-merge-personality>.bin. The firmware is converted from
      Apple's multitouch firmware.

  apple,hid-merge-personality:
    $ref: /schemas/types.yaml#/definitions/string
    description:
      The ADT's hid-merge-personality, the firmware variant this unit needs.

  apple,z2-cal-blob:
    $ref: /schemas/types.yaml#/definitions/uint8-array
    description: The ADT's multi-touch-calibration.

patternProperties:
  "^apple,luna-[a-z-]+$":
    $ref: /schemas/types.yaml#/definitions/uint8-array
    description: The ADT's 3D Touch calibrations, under their ADT names.

required:
  - compatible
  - reg
  - interrupts
  - reset-gpios
  - ana-supply
  - clocks
  - firmware-name
  - apple,hid-merge-personality

unevaluatedProperties: false

examples:
  - |
    #include <dt-bindings/gpio/gpio.h>
    #include <dt-bindings/interrupt-controller/irq.h>

    spi {
        #address-cells = <1>;
        #size-cells = <0>;

        touchscreen@0 {
            compatible = "apple,d221-touchscreen";
            reg = <0>;
            spi-max-frequency = <4000000>;
            interrupts-extended = <&pinctrl_aop 21 IRQ_TYPE_LEVEL_LOW>;
            reset-gpios = <&pinctrl_ap 33 GPIO_ACTIVE_LOW>;
            ana-supply = <&touch_ana>;
            clocks = <&touchclk>;
            firmware-name = "apple/d221-touch";
            apple,hid-merge-personality = "C1R1FC0,2";
            touchscreen-size-x = <1125>;
            touchscreen-size-y = <2436>;
        };
    };

...
```

## Documentation/devicetree/bindings/leds/backlight/apple,dsi-bl.yaml
```yaml
# SPDX-License-Identifier: (GPL-2.0 OR BSD-2-Clause)
%YAML 1.2
---
$id: http://devicetree.org/schemas/leds/backlight/apple,dsi-bl.yaml#
$schema: http://devicetree.org/meta-schemas/core.yaml#

title: Apple OLED panel brightness over the MIPI DSI host

maintainers:
  - Eduardo Martins <eduardo@martins.ws>

description:
  The OLED iPhones have no DWI backlight controller. iOS sets their panel's
  brightness with the MIPI DCS "set display brightness" command (0x51) and an
  11-bit display brightness value, sent through the SoC's Synopsys
  DesignWare MIPI DSI host while the display runs in video mode. The node
  takes the host's command registers; the ADT's backlight node gives the
  value range (DBVMin, DBVMax) and the boot level.

allOf:
  - $ref: common.yaml#

properties:
  compatible:
    items:
      - enum:
          - apple,t8015-dsi-bl
      - const: apple,dsi-bl

  reg:
    maxItems: 1
    description: The DSI host's register window.

  power-domains:
    maxItems: 1

  max-brightness:
    maximum: 2047

  apple,min-dbv:
    $ref: /schemas/types.yaml#/definitions/uint32
    maximum: 2047
    description:
      The lowest display brightness value the panel takes (the ADT's
      DBVMin); lower levels are raised to it.

required:
  - compatible
  - reg

unevaluatedProperties: false

examples:
  - |
    soc {
      #address-cells = <2>;
      #size-cells = <2>;

      backlight@218400000 {
        compatible = "apple,t8015-dsi-bl", "apple,dsi-bl";
        reg = <0x2 0x18400000 0x0 0x100>;
        power-domains = <&ps_mipi_dsi>;
        max-brightness = <2047>;
        apple,min-dbv = <139>;
        default-brightness-level = <740>;
      };
    };
```
